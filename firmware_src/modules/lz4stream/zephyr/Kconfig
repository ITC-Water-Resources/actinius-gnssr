## firmware_src/modules/lz4stream/zephyr/Kconfig
```kconfig
# Copyright (c) 2020 Linumiz
# SPDX-License-Identifier: Apache-2.0

config ZEPHYR_LZ4STREAM_MODULE
	bool

config LZ4STREAM
	bool "Lz4 data compression and decompression (stream format)"
	help
	  This option enables lz4  stream compression & decompression library
	  support.
```
